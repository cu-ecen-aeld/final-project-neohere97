## base_external/Config.in
```kconfig
source "$BR2_EXTERNAL_project_base_PATH/package/aesd-assignments/Config.in"
source "$BR2_EXTERNAL_project_base_PATH/package/ldd/Config.in"
source "$BR2_EXTERNAL_project_base_PATH/package/application-code/Config.in"
source "$BR2_EXTERNAL_project_base_PATH/package/pwm-test/Config.in"
```

## base_external/configs/aesd_rpi_defconfig
```kconfig
BR2_arm=y
BR2_cortex_a72=y
BR2_ARM_FPU_NEON_VFPV4=y
BR2_PACKAGE_HOST_LINUX_HEADERS_CUSTOM_5_10=y
BR2_TOOLCHAIN_BUILDROOT_CXX=y
BR2_TARGET_GENERIC_HOSTNAME="neopc"
BR2_TARGET_GENERIC_ISSUE="Welcome to Image Streamer"
BR2_TARGET_GENERIC_ROOT_PASSWD="12345"
BR2_SYSTEM_BIN_SH_BASH=y
BR2_SYSTEM_DHCP="eth0"
BR2_TARGET_TZ_INFO=y
BR2_ROOTFS_POST_BUILD_SCRIPT="board/raspberrypi4/post-build.sh"
BR2_ROOTFS_POST_IMAGE_SCRIPT="board/raspberrypi4/post-image.sh"
BR2_LINUX_KERNEL=y
BR2_LINUX_KERNEL_CUSTOM_TARBALL=y
BR2_LINUX_KERNEL_CUSTOM_TARBALL_LOCATION="$(call github,raspberrypi,linux,0b54dbda3cca2beb51e236a25738784e90853b64)/linux-0b54dbda3cca2beb51e236a25738784e90853b64.tar.gz"
BR2_LINUX_KERNEL_DEFCONFIG="bcm2711"
BR2_LINUX_KERNEL_DTS_SUPPORT=y
BR2_LINUX_KERNEL_INTREE_DTS_NAME="bcm2711-rpi-4-b"
BR2_LINUX_KERNEL_NEEDS_HOST_OPENSSL=y
BR2_PACKAGE_LINUX_TOOLS_GPIO=y
BR2_PACKAGE_FFMPEG_FFPLAY=y
BR2_PACKAGE_V4L2GRAB=y
BR2_PACKAGE_V4L2LOOPBACK=y
BR2_PACKAGE_V4L2LOOPBACK_UTILS=y
BR2_PACKAGE_GZIP=y
BR2_PACKAGE_ZIP=y
BR2_PACKAGE_BINUTILS=y
BR2_PACKAGE_BINUTILS_TARGET=y
BR2_PACKAGE_GIT_CRYPT=y
BR2_PACKAGE_GPERF=y
BR2_PACKAGE_GREP=y
BR2_PACKAGE_MAKE=y
BR2_PACKAGE_RPI_FIRMWARE=y
BR2_PACKAGE_RPI_FIRMWARE_VARIANT_PI4=y
BR2_PACKAGE_RPI_FIRMWARE_VARIANT_PI4_X=y
BR2_PACKAGE_RPI_FIRMWARE_CONFIG_FILE="board/raspberrypi4/config_4.txt"
BR2_PACKAGE_FCONFIG=y
BR2_PACKAGE_I2C_TOOLS=y
BR2_PACKAGE_LM_SENSORS=y
BR2_PACKAGE_LM_SENSORS_FANCONTROL=y
BR2_PACKAGE_LM_SENSORS_PWMCONFIG=y
BR2_PACKAGE_PIFMRDS=y
BR2_PACKAGE_PIGPIO=y
BR2_PACKAGE_RASPI_GPIO=y
BR2_PACKAGE_RPI_USERLAND=y
BR2_PACKAGE_RPI_USERLAND_HELLO=y
BR2_PACKAGE_SPI_TOOLS=y
BR2_PACKAGE_MICROPYTHON=y
BR2_PACKAGE_MICROPYTHON_LIB=y
BR2_PACKAGE_PYTHON3=y
BR2_PACKAGE_BCM2835=y
BR2_PACKAGE_LIBGPHOTO2=y
BR2_PACKAGE_LIBSERIAL=y
BR2_PACKAGE_LIBSERIALPORT=y
BR2_PACKAGE_LIBV4L_UTILS=y
BR2_PACKAGE_RPI_RGB_LED_MATRIX=y
BR2_PACKAGE_RPI_RGB_LED_MATRIX_IMAGE_VIEWER=y
BR2_PACKAGE_RPI_RGB_LED_MATRIX_TEXT_SCROLLER=y
BR2_PACKAGE_RPI_RGB_LED_MATRIX_VIDEO_VIEWER=y
BR2_PACKAGE_BENTO4=y
BR2_PACKAGE_C_ARES=y
BR2_PACKAGE_LIBCURL=y
BR2_PACKAGE_LIBCURL_CURL=y
BR2_PACKAGE_LIBCURL_VERBOSE=y
BR2_PACKAGE_NGHTTP2=y
BR2_PACKAGE_LIBUV=y
BR2_PACKAGE_NET_TOOLS=y
BR2_PACKAGE_NETSTAT_NAT=y
BR2_PACKAGE_OPENSSH=y
BR2_PACKAGE_WGET=y
BR2_PACKAGE_WHOIS=y
BR2_PACKAGE_WIRELESS_TOOLS=y
BR2_PACKAGE_WIRELESS_TOOLS_LIB=y
BR2_PACKAGE_WPA_SUPPLICANT=y
BR2_PACKAGE_BASH_COMPLETION=y
BR2_PACKAGE_NEOFETCH=y
BR2_PACKAGE_TIME=y
BR2_PACKAGE_WHICH=y
BR2_PACKAGE_XDG_DBUS_PROXY=y
BR2_PACKAGE_NANO=y
BR2_TARGET_ROOTFS_EXT2=y
BR2_TARGET_ROOTFS_EXT2_4=y
BR2_TARGET_ROOTFS_EXT2_SIZE="1024M"
# BR2_TARGET_ROOTFS_TAR is not set
BR2_PACKAGE_HOST_DOSFSTOOLS=y
BR2_PACKAGE_HOST_GENIMAGE=y
BR2_PACKAGE_HOST_MTOOLS=y
BR2_PACKAGE_HOST_PYTHON3=y
BR2_PACKAGE_HOST_PYTHON3_BZIP2=y
BR2_PACKAGE_HOST_PYTHON3_SSL=y
BR2_PACKAGE_HOST_QEMU=y
```
